&kscan2 {
    compatible = "zmk,kscan-gpio-matrix";
    diode-direction = "col2row";
    wakeup-source;

    /delete-property/ columns;
    /delete-property/ rows;
    /delete-property/ events;

    row-gpios = <&xiao_d 4 (GPIO_ACTIVE_HIGH | GPIO_PULL_DOWN)>;
    col-gpios = <&xiao_d 5 GPIO_ACTIVE_HIGH>;
};

&encoder {
    status = "okay";
};

&spi0 {
    status = "disabled";
};

&sensors {
    triggers-per-rotation = <12>;
};
